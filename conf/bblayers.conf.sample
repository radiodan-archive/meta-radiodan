## conf/bblayers.conf.sample
```bitbake
# LAYER_CONF_VERSION is increased each time build/conf/bblayers.conf
# changes incompatibly
LCONF_VERSION = "6"

BBPATH = "${TOPDIR}"
BBFILES ?= ""
BBLAYERS = " \
  ${TOPDIR}/../meta \
  ${TOPDIR}/../meta-yocto \
  ${TOPDIR}/../meta-openembedded/meta-oe \
  ${TOPDIR}/../meta-openembedded/meta-webserver \
  ${TOPDIR}/../meta-openembedded/meta-multimedia \
  ${TOPDIR}/../meta-openembedded/meta-python \
  ${TOPDIR}/../meta-openembedded/meta-networking \
  ${TOPDIR}/../meta-openembedded/meta-ruby \
  ${TOPDIR}/../meta-raspberrypi \
  ${TOPDIR}/../meta-radiodan \
  "
```

## conf/distro/preferred-versions.conf
```bitbake
SPLASH = "psplash"

# We have to build for softfloat eabi because the libspotify binary blob
# is built that way
DEFAULTTUNE_raspberrypi2 = "cortexa7t-neon"
DEFAULTTUNE_raspberrypi  = "arm1176jzfs"

# The vfp tune is missing from pkg archs
PACKAGE_EXTRA_ARCHS_tune-arm1176jzfs = "${PACKAGE_EXTRA_ARCHS_tune-armv6} arm1176jzfs-vfp"
```

## conf/distro/radiodan.conf
```bitbake
# Poky slightly rebranded
require conf/distro/preferred-versions.conf
require conf/distro/poky.conf

# We have a number of precompiled proprietrary binaries that fail on number
# of these checks (hash, rpaths), so warn rather than fail on these
#ERROR_QA = "dev-so debug-deps dev-deps debug-files arch la2 pkgconfig la perms staticdev"
#WARN_QA = "ldflags useless-rpaths rpaths unsafe-references-in-binaries unsafe-references-in-scripts libdir"

RADIODAN_VERSION_MAJOR="2"
RADIODAN_VERSION_MINOR="0"
RADIODAN_VERSION_MICRO="0"
RADIODAN_VERSION_NOTE="${@' (development snapshot)' if ${RADIODAN_VERSION_MINOR} % 2 else ''}"
RADIODAN_DISTRO_NAME = "Radiodan"

export RADIODAN_VERSION_MAJOR
export RADIODAN_VERSION_MINOR
export RADIODAN_VERSION_MICRO
export RADIODAN_VERSION_NOTE
export RADIODAN_DISTRO_NAME

DISTRO = "radiodan"
DISTRO_NAME = "${RADIODAN_DISTRO_NAME}"
DISTRO_VERSION = "${RADIODAN_VERSION_MAJOR}.${RADIODAN_VERSION_MINOR}.${RADIODAN_VERSION_MICRO}${RADIODAN_VERSION_NOTE}"
MAINTAINER = "Radiodan Project <http://radiodan.net>"

DEFAULT_TIMEZONE ?= "Europe/London"

DISTRO_FEATURES_DEFAULT = "alsa ext2 usbhost wifi xattr zeroconf pam"
DISTRO_FEATURES = "${DISTRO_FEATURES_DEFAULT} ${DISTRO_FEATURES_LIBC}"
#VIRTUAL-RUNTIME_init_manager = "systemd"

# The RPi boot partion name
#BOOTDD_VOLUME_ID = "boot"
#SDIMG_ROOTFS_TYPE = "ext4"
```

## conf/layer.conf
```bitbake
# We have a conf and classes directory, add to BBPATH
BBPATH =. "${LAYERDIR}:"

# We have a packages directory, add to BBFILES
BBFILES += "${LAYERDIR}/recipes-*/*/*.bb \
            ${LAYERDIR}/recipes-*/*/*.bbappend"

BBFILE_COLLECTIONS += "radiodan"
BBFILE_PATTERN_radiodan = "^${LAYERDIR}/"
BBFILE_PRIORITY_radiodan = "7"

LICENSE_PATH += "${LAYERDIR}/files/additional-licenses"

INHERIT += "radiodanmanifest"
```

## conf/local.conf.sample
```bitbake
# To avoid hitting repositories for every package using AUTOREV, you can
# uncomment the following -- this speeds up the builds, but no changes from the
# upstream repos will be pulled in.  Mostly useful if you are rebuilding a
# package from a local copy of a repo
#BB_SRCREV_POLICY = "cache"

# To enable debug builds
#DEBUG_BUILD = "1"
#INHIBIT_PACKAGE_STRIP = "1"

# Parallelization options; for a dedicated build machine, make this match the
# number of cores. If you need to use the machine for other stuff while the
# build is running, cores - 2 is a reasonable option.
BB_NUMBER_THREADS = "${@oe.utils.cpu_count() - 2}"
PARALLEL_MAKE = "-j ${@oe.utils.cpu_count() - 2}"

MACHINE  ?= "raspberrypi"
DISTRO ?= "radiodan"
PACKAGE_CLASSES ?= "package_ipk"
SDKMACHINE ?= "i686"

# If you are having issues with gnome-terminal, you might want to switch to
# devshell and such to the plain old xterm
#OE_TERMINAL = "xterm"

#  "dbg-pkgs"       - add -dbg packages for all installed packages
#                     (adds symbol information for debugging/profiling)
#  "dev-pkgs"       - add -dev packages for all installed packages
#                     (useful if you want to develop against libs in the image)
#  "tools-sdk"      - add development tools (gcc, make, pkgconfig etc.)
#  "tools-debug"    - add debugging tools (gdb, strace)
#  "tools-profile"  - add profiling tools (oprofile, exmap, lttng, valgrind)
#  "tools-testapps" - add useful testing tools (ts_print, aplay, arecord etc.)
#  "debug-tweaks"   - make an image suitable for development
#                     e.g. ssh root access has a blank password
#
#EXTRA_IMAGE_FEATURES = "debug-tweaks"

#
# Where to place downloads
#
# During a first build the system will download many different source code
# tarballs from various upstream projects. This can take a while, particularly
# if your network connection is slow. These are all stored in DL_DIR. When
# wiping and rebuilding you can preserve this directory to speed up this part of
# subsequent builds. This directory is safe to share between multiple builds on
# the same machine too.
#
# The default is a downloads directory under TOPDIR which is the build directory.
#
DL_DIR ?= "${TOPDIR}/sources"

#
# Where to place shared-state files
#
# BitBake has the capability to accelerate builds based on previously built
# output.  This is done using "shared state" files which can be thought of as
# cache objects and this option determines where those files are placed.
#
# You can wipe out TMPDIR leaving this directory intact and the build would
# regenerate from these files if no changes were made to the configuration. If
# changes were made to the configuration, only shared state files where the
# state was still valid would be used (done using checksums).
#
# The default is a sstate-cache directory under TOPDIR.
#
#SSTATE_DIR ?= "${TOPDIR}/sstate-cache"

#
# Where to place the build output
#
# This option specifies where the bulk of the building work should be done and
# where BitBake should place its temporary files and output. Keep in mind that
# this includes the extraction and compilation of many applications and the
# toolchain which can use Gigabytes of hard disk space.
#
# The default is a tmp directory under TOPDIR.
#
#TMPDIR = "${TOPDIR}/tmp"

USER_CLASSES ?= "buildstats image-mklibs image-prelink"
PATCHRESOLVE = "noop"
CONF_VERSION = "1"
ENABLE_BINARY_LOCALE_GENERATION = "1"

#
# Disk Space Monitoring during the build
#
# Monitor the disk space during the build. If there is less that 1GB of space or
# less than 100K inodes in any key build location (TMPDIR, DL_DIR, SSTATE_DIR),
# gracefully shutdown the build. If there is less that 100MB or 1K inodes,
# perform a hard abort of the build. The reason for this is that running
# completely out of space can corrupt files and damages the build in ways which
# may not be easily recoverable.
BB_DISKMON_DIRS = "\
    STOPTASKS,${TMPDIR},1G,100K \
    STOPTASKS,${DL_DIR},1G,100K \
    STOPTASKS,${SSTATE_DIR},1G,100K \
    ABORT,${TMPDIR},100M,1K \
    ABORT,${DL_DIR},100M,1K \
    ABORT,${SSTATE_DIR},100M,1K"
```
